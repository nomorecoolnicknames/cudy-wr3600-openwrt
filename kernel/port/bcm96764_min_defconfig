## kernel/port/bootfs66.its
```
/dts-v1/;
/ {
	description = "Simple image with ATF and optional OP-TEE support";
	#address-cells = <1>;
	ident_1 = "@(#) $imageversion: 5044p3GW_WL23D2D1GA_WLMLO1651633(BSPv1W13) $";
	ident_2 = "@(#) $imageversion: 5044p3GW_WL23D2D1GA_WLMLO1651633(BSPv1W13) $";
	ident_3 = "@(#) $imgversion: 5.04L.04p3 $";
	ident_4 = "@(#) $imgversion: 5.04L.04p3 $";
	images {
		kernel {
			description = "Linux kernel";
			data = /incbin/("Image.lzma");
			type = "kernel";
			os = "linux";
			arch = "arm";
			compression = "lzma";
			load = <0x108000>;
			entry = <0x108000>;
			hash-1 { algo = "sha256"; };
		};
		fdt_96764SV1 {
			description = "dtb";
			data = /incbin/("fdt.dtb");
			type = "flat_dt";
			arch = "arm";
			compression = "none";
			hash-1 { algo = "sha256"; };
		};
	};
	configurations {
		default = "conf_ub_96764SV1";
		conf_lx_96764SV1 {
			description = "BRCM 63xxx linux";
			kernel = "kernel";
			fdt = "fdt_96764SV1";
		};
	};
};
```
